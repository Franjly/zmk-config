## config/west.yml
```yaml
manifest:
  defaults:
    revision: v0.3
  remotes:
    - name: zmkfirmware
      url-base: https://github.com/zmkfirmware
    # Toucan
    - name: petejohanson
      url-base: https://github.com/petejohanson/
    - name: caksoylar
      url-base: https://github.com/caksoylar
    # Prospector Scanner
    - name: prospector
      url-base: https://github.com/t-ogura
    # nice-view-gem
    - name: m165437
      url-base: https://github.com/M165437
    # Prospector - Carrefinho
    - name: carrefinho
      url-base: https://github.com/carrefinho
  projects:
    - name: zmk
      remote: zmkfirmware
      import: app/west.yml
    # Toucan
    - name: cirque-input-module
      remote: petejohanson
      revision: main
    - name: zmk-rgbled-widget
      remote: caksoylar
      revision: main
    # Prospector Scanner
    - name: prospector-scanner-zmk-module
      remote: prospector
      repo-path: prospector-zmk-module
      revision: v2.0.0
      path: modules/prospector-zmk-module
    # nice-view-gem
    - name: nice-view-gem
      remote: m165437
      revision: main
    # Prospector - Carrefinho
    - name: prospector-carrefinho'zmk-module
      remote: carrefinho
      repo-path: prospector-zmk-module
      revision: main
      path: modules/prospector-zmk-module
  self:
    path: config
```
